## idris-apps/hello-idris-2/Kconfig
```kconfig
#
# Copyright 2018, Mokshasoft AB (mokshasoft.com)
#
# This software may be distributed and modified according to the terms of
# the BSD 2-Clause license. Note that NO WARRANTY is provided.
# See "LICENSE_BSD2.txt" for details.
#

menuconfig APP_HELLO_IDRIS_2
    bool "seL4 Hello Idris #2"
    default n
    depends on LIB_SEL4 && (LIB_MUSL_C || LIB_SEL4_C) && LIB_SEL4_PLAT_SUPPORT && LIB_UTILS && LIBSEL4_IDRIS_RTS
    help
       An example of how to compile an Idris seL4 application.
```
